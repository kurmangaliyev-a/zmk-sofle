## config/west.yml
```yaml
manifest:
  remotes:
    - name: zmkfirmware
      url-base: https://github.com/zmkfirmware
    - name: mrbanh
      url-base: https://github.com/MrBanh
    - name: m165437
      url-base: https://github.com/M165437
  projects:
    - name: zmk
      remote: zmkfirmware
      revision: v0.3.0
      import: app/west.yml
    - name: nice-view-bongo-cat
      remote: mrbanh
      revision: main
    - name: nice-view-gem
      remote: m165437
      revision: v0.3.0
  self:
    path: config
```
